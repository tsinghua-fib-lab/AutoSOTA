## ICML-2026/paper-1208-DVS/best_code/config/sample.yaml
```yaml
data: 
  data: sbm

sampler:
  predictor: Euler
  corrector: None
  snr: 0.0
  scale_eps: 0.0
  n_steps: 1

sample:
  batch_size: 40
  use_ema: True 
  eps: 2.0e-3 
  kernel: tv
  noise_removal: True
  seed: 42

ckpt: sbm
```
